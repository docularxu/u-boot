## drivers/clk/spacemit/Kconfig
```kconfig
# SPDX-License-Identifier: GPL-2.0-or-later
#
# Copyright (c) 2025, Junhui Liu <junhui.liu@pigmoral.tech>

config CLK_SPACEMIT
	bool "Clock support for SpacemiT SoCs"
	depends on CLK
	depends on REGMAP

if CLK_SPACEMIT

config CLK_SPACEMIT_K1
	bool "SpacemiT K1 clock support"
	select CLK_CCF
	default SPACEMIT_K1
	help
	  This enables support clock driver for SpacemiT K1 SoC.

config SPL_CLK_SPACEMIT_K1
	bool "Enable Spacemit K1 SoC clock support in SPL"
	select SPL_CLK_CCF
	default SPACEMIT_K1
	help
	  It allows to use clock driver in SPL.

endif
```

## drivers/ram/spacemit/Kconfig
```kconfig
config DRAM_SPACEMIT_K1
	bool "DRAM driver support for Spacemit K1 SoC"
	default y if SPACEMIT_K1
	depends on RAM
	help
	  This enables support for the DRAM controller driver for
	  Spacemit K1 SoC.

config SPL_DRAM_SPACEMIT_K1
	bool "DRAM driver support for Spacemit K1 SoC in SPL"
	default y if SPACEMIT_K1 && SPL
	depends on RAM
	help
	  This enables support for the DRAM controller driver in SPL
	  for Spacemit K1 SoC.
```
